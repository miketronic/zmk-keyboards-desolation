## boards/shields/desolation/Kconfig.defconfig
```kconfig
# Copyright (c) 2025 The ZMK Contributors
# SPDX-License-Identifier: MIT

if SHIELD_DESOLATION

config ZMK_KEYBOARD_NAME
    default "Desolation"

config ZMK_POINTING
    default y

config SPI
    default y

endif
```

## boards/shields/desolation/Kconfig.shield
```kconfig
# Copyright (c) 2025 The ZMK Contributors
# SPDX-License-Identifier: MIT

config SHIELD_DESOLATION
    def_bool $(shields_list_contains,desolation)
```
