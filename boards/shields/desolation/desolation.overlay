/*
 * Copyright (c) 2025 miketronic
 * SPDX-License-Identifier: MIT
 * Desolation v4
 */

#include <input/processors.dtsi>
#include <dt-bindings/zmk/input_transform.h>
#include <dt-bindings/zmk/keys.h>
#include <zephyr/dt-bindings/input/input-event-codes.h>
#include "desolation.dtsi"

/ {
    kscan0: kscan {
        compatible = "zmk,kscan-gpio-matrix";
        diode-direction = "col2row";
        wakeup-source;
        col-gpios
            = <&pro_micro 10 (GPIO_ACTIVE_HIGH)> // COL0
            , <&pro_micro 18 (GPIO_ACTIVE_HIGH)> // COL1
            , <&pro_micro 15 (GPIO_ACTIVE_HIGH)> // COL2
            , <&pro_micro 14 (GPIO_ACTIVE_HIGH)> // COL3
            , <&pro_micro 16 (GPIO_ACTIVE_HIGH)> // COL4
            , <&pro_micro 8 (GPIO_ACTIVE_HIGH)> // COL5
            , <&pro_micro 7 (GPIO_ACTIVE_HIGH)> // COL6
            , <&pro_micro 6 (GPIO_ACTIVE_HIGH)> // COL7
            , <&pro_micro 5 (GPIO_ACTIVE_HIGH)> // COL8
            , <&pro_micro 4 (GPIO_ACTIVE_HIGH)> // COL9
            , <&gpio1 1     (GPIO_ACTIVE_HIGH)> // COL10
            , <&gpio1 2     (GPIO_ACTIVE_HIGH)> // COL11
            ;
        row-gpios
            = <&pro_micro 19 (GPIO_ACTIVE_HIGH | GPIO_PULL_DOWN)> // ROW0
            , <&pro_micro 9  (GPIO_ACTIVE_HIGH | GPIO_PULL_DOWN)> // ROW1
            , <&pro_micro 21 (GPIO_ACTIVE_HIGH | GPIO_PULL_DOWN)> // ROW2
            , <&pro_micro 20 (GPIO_ACTIVE_HIGH | GPIO_PULL_DOWN)> // ROW3
            , <&gpio1 7      (GPIO_ACTIVE_HIGH | GPIO_PULL_DOWN)> // ROW4
            ;
    };
};
